## boards/arm/bluemacro840/Kconfig.defconfig
```kconfig
# BlueMacro840 board configuration

# Copyright (c) 2020 Pete Johanson, Derek Schmell
# SPDX-License-Identifier: MIT

if BOARD_BLUEMACRO840_V1

config BOARD
    default "bluemacro840_v1"

if USB_DEVICE_STACK

config USB_NRFX
    default y

endif # USB_DEVICE_STACK

config BT_CTLR
    default BT

endif # BOARD_BLUEMACRO840_V1
```

## boards/arm/filco_daughterboard/Kconfig.board
```kconfig
# Filco Daughterboard board configuration

# Copyright (c) 2020 Pete Johanson, Derek Schmell
# SPDX-License-Identifier: MIT

config BOARD_FILCO_DAUGHTERBOARD
    bool "Filco Daughterboard Majestouch Convertible 2"
    depends on SOC_NRF52840_QIAA
```

## boards/arm/filco_daughterboard/Kconfig.defconfig
```kconfig
# Filco Daughterboard board configuration

# Copyright (c) 2020 Pete Johanson, Derek Schmell
# SPDX-License-Identifier: MIT

if BOARD_FILCO_DAUGHTERBOARD

config BOARD
    default "filco_daughterboard"

if USB_DEVICE_STACK

config USB_NRFX
    default y

endif # USB_DEVICE_STACK

config BT_CTLR
    default BT

endif # BOARD_FILCO_DAUGHTERBOARD
```

## boards/karl5275/filco_daughterboard/Kconfig.filco_daughterboard
```kconfig
# Copyright (c) 2024 The ZMK Contributors
# SPDX-License-Identifier: Apache-2.0

config BOARD_FILCO_DAUGHTERBOARD
    select SOC_NRF52840_QIAA
    select ZMK_BOARD_COMPAT if BOARD_FILCO_DAUGHTERBOARD_NRF52840_ZMK
    imply RETAINED_MEM
    imply RETENTION
    imply RETENTION_BOOT_MODE
```

## boards/karl5275/filco_daughterboard/board.yml
```yaml
board:
  name: filco_daughterboard
  vendor: karl5275
  socs:
    - name: nrf52840
      variants:
        - name: zmk
```

## boards/karl5275/filco_daughterboard/filco_daughterboard_nrf52840_zmk_defconfig
```kconfig
# SPDX-License-Identifier: MIT

# Enable MPU
CONFIG_ARM_MPU=y

# enable GPIO
CONFIG_GPIO=y

CONFIG_USE_DT_CODE_PARTITION=y
CONFIG_BUILD_OUTPUT_UF2=y

CONFIG_MPU_ALLOW_FLASH_WRITE=y
CONFIG_NVS=y
CONFIG_SETTINGS_NVS=y
CONFIG_FLASH=y
CONFIG_FLASH_PAGE_LAYOUT=y
CONFIG_FLASH_MAP=y

CONFIG_ZMK_USB=y
CONFIG_ZMK_BLE=y

# USB device identity (values in hex)
CONFIG_USB_DEVICE_VID=0x16D0
CONFIG_USB_DEVICE_PID=0x1463
```

## boards/shields/filco_majestouch_conv2/Kconfig.defconfig
```kconfig
if SHIELD_FILCO_MAJESTOUCH_CONV2

config ZMK_KEYBOARD_NAME
    default "Filco Majestouch Convertible 2"

endif
```

## boards/shields/filco_majestouch_conv2/Kconfig.shield
```kconfig
config SHIELD_FILCO_MAJESTOUCH_CONV2
    def_bool $(shields_list_contains,filco_majestouch_conv2)
    select GPIO
    # select ADC
```

## dts/bindings/behaviors/zmk,behavior-bt-picker.yaml
```yaml
# Copyright (c) 2024 The ZMK Contributors
# SPDX-License-Identifier: MIT

description: |
  Toggle the firmware-driven BT device-picker mode. On press it flips the
  picker on/off via the indicator LED module (sets the menu flag + locks/
  unlocks the picker layer). Zero binding cells.

compatible: "zmk,behavior-bt-picker"

include: zero_param.yaml
```
